## meta-eswin/conf/layer.conf
```bitbake
# SPDX-License-Identifier: MIT
# 
# Copyright 2024 Beijing ESWIN Computing Technology Co., Ltd.  
#      Author: chenyuanbo <chenyuanbo@eswincomputing.com>
#      

# We have a conf and classes directory, add to BBPATH
BBPATH .= ":${LAYERDIR}"

# We have recipes-* directories, add to BBFILES
BBFILES += "${LAYERDIR}/recipes-*/*/*.bb \
            ${LAYERDIR}/recipes-*/*/*.bbappend"

BBFILE_COLLECTIONS += "meta-eswin"
BBFILE_PATTERN_meta-eswin = "^${LAYERDIR}/"
BBFILE_PRIORITY_meta-eswin = "6"

LAYERDEPENDS_meta-eswin = "core"
LAYERSERIES_COMPAT_meta-eswin = "mickledore"
```

## meta-eswin/conf/machine/S500.conf
```bitbake
# SPDX-License-Identifier: MIT
#
# Copyright 2024 Beijing ESWIN Computing Technology Co., Ltd.
#      Author: chenyuanbo <chenyuanbo@eswincomputing.com>
#

require conf/machine/include/riscv/tune-riscv.inc

MACHINE_FEATURES = "serial"

KERNEL_IMAGETYPE = "Image"

PREFERRED_PROVIDER_virtual/kernel ?= "linux-mainline"
PREFERRED_PROVIDER_virtual/bootloader ?= "u-boot"
PREFERRED_VERSION_u-boot = "2022.07"

EXTRA_IMAGEDEPENDS += "u-boot"
UBOOT_MACHINE ?= "S500-${PLAT}_defconfig"
RISCV_SBI_PAYLOAD = "u-boot.bin"

EXTRA_IMAGEDEPENDS += "opensbi"
PREFERRED_VERSION_opensbi = "1.0"
RISCV_SBI_PLAT = "eswin/S500"
RISCV_SBI_FDT ?= "S500-${PLAT}_uboot.dtb"

MACHINE_EXTRA_RRECOMMENDS += " kernel-modules"
SERIAL_CONSOLES = "38400;ttyS0"
IMAGE_FSTYPES += "ext4 cpio.gz"
KERNEL_DEVICETREE ?= "eswin/S500-${PLAT}.dtb"

DISTRO_FEATURES:remove= "bluetooth pcmcia usbgadget usbhost wifi nfs pci 3g nfc"
DISTRO_FEATURES += "sysvinit"

VIRTUAL-RUNTIME_init_manager ?= "busybox"
VIRTUAL-RUNTIME_login_manager ?= "busybox"
DISTRO_FEATURES_BACKFILL_CONSIDERED += "sysvinit"
VIRTUAL-RUNTIME_dev_manager ?= "busybox-mdev"
```
